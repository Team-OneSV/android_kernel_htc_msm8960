## arch/arm/mach-msm/htc/k2_cl/Kconfig
```kconfig
config BOARD_HEADER_FILE
        string "HTC board specific header file name"
        default ""

config MACH_K2_CL
        depends on ARCH_MSM8930
        select MACH_HTC
        bool "HTC One SV (Boost Mobile)"
        help
          Support for the HTC One SV (Boost Mobile) device.
```
